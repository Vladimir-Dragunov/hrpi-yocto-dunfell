## conf/distro/rpi-black.conf
```bitbake
include conf/distro/poky.conf
include conf/distro/include/ha-versions.inc

MAINTAINER = "Vladimir Dragunov <contact.marushkevich@gmail.com>"

DISTRO = "rpi-black"
DISTRO_NAME = "Raspberry Pi 4-64 Dragunov Project"
DISTRO_VERSION = "v1"
DISTRO_CODENAME = "luna"

ENABLE_UART = "1"

DISTRO_FEATURES_append = " \
	systemd \
"

DISTRO_FEATURES_BACKFILL_CONSIDERED += "sysvinit"
VIRTUAL-RUNTIME_init_manager = "systemd"
VIRTUAL-RUNTIME_initscripts = "systemd-compat-units"

IMAGE_FEATURES_append = " \
	ssh-server-openssh \
"

IMAGE_FEATURES_remove = " \
	splash \
"

IMAGE_FSTYPES="tar.bz2 ext4 wic.bz2 wic.bmap"
SDIMG_ROOTFS_TYPE="ext4"

RPI_USE_U_BOOT = "1"
PREFERRED_PROVIDER_virtual/bootloader = "u-boot"

WKS_FILE = "sdimage-dual-raspberrypi.wks"
```

## conf/layer.conf
```bitbake
# We have a conf and classes directory, add to BBPATH
BBPATH .= ":${LAYERDIR}"

# We have recipes-* directories, add to BBFILES
BBFILES += "${LAYERDIR}/recipes-*/*/*.bb \
            ${LAYERDIR}/recipes-*/*/*.bbappend"

BBFILE_COLLECTIONS += "meta-rpi-project"
BBFILE_PATTERN_meta-rpi-project = "^${LAYERDIR}/"
BBFILE_PRIORITY_meta-rpi-project = "6"

LAYERDEPENDS_meta-rpi-project = "core"
LAYERSERIES_COMPAT_meta-rpi-project = "dunfell"
```
